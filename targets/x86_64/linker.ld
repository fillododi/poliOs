ENTRY(loader)

SECTIONS{
    . = 1M;
    .boot :
    {
        KEEP(*(.multiboot_header))
    }
    .text :
    {
        *(.text*)
        *(.rodata)
    }
    .data :
    {
        start_ctors = .;
        KEEP(*(.init_array));
        KEEP(*(SORT_BY_INIT_PRIORITY(.init_array.*)));
        end_ctors = .;

        *(.data)
    }
    .bss :
    {
        *(.bss)
    }
    /DISCARD/ :
    {
        *(.fini_array*)
        *(.comment)
    }
}